## cfengine-policies/Config.in
```kconfig
choice
    depends on PACKAGE_cfengine-policies
    prompt "Network profile"
    default NETWORK_PROFILE_APU

    config NETWORK_PROFILE_ALIX
        bool "ALIX"

    config NETWORK_PROFILE_APU
        bool "APU"

    config NETWORK_PROFILE_RASPI
        bool "Rasperry Pi"

endchoice
```
